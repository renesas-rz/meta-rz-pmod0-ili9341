## conf/layer.conf
```bitbake
# We have a conf and classes directory, add to BBPATH

include ${LAYERDIR}/include/graphic/extend_packages.inc

BBPATH .= ":${LAYERDIR}"

# We have recipes-* directories, add to BBFILES
BBFILES += "${LAYERDIR}/recipes-*/*/*.bb \
            ${LAYERDIR}/recipes-*/*/*.bbappend \
            ${LAYERDIR}/recipes-*/*/*/*.bb \
            ${LAYERDIR}/recipes-*/*/*/*.bbappend"

BBFILE_COLLECTIONS += "meta-rz-pmod0-ili9341"
BBFILE_PATTERN_meta-rz-pmod0-ili9341  = "^${LAYERDIR}/"
BBFILE_PRIORITY_meta-rz-pmod0-ili9341 = "5"

LAYERDEPENDS_meta-rz-pmod0-ili9341 = "core"
LAYERSERIES_COMPAT_meta-rz-pmod0-ili9341 = "dunfell"
```
